## stageMosaicoIoT/main/Kconfig.projbuild
```kconfig
menu "Modbus Master Configuration"

    config MB_UART_PORT_NUM
        int "UART port number"
        range 0 2 if IDF_TARGET_ESP32 || IDF_TARGET_ESP32S3
        default 1 if IDF_TARGET_ESP32C6
        range 0 1 if IDF_TARGET_ESP32C2 || IDF_TARGET_ESP32C3 || IDF_TARGET_ESP32C6 || IDF_TARGET_ESP32H2 || IDF_TARGET_ESP32C5 || IDF_TARGET_ESP32C61
        range 0 2 if IDF_TARGET_ESP32S2
        range 0 4 if IDF_TARGET_ESP32P4
        help
            UART communication port number for Modbus Master.

    config MB_UART_BAUD_RATE
        int "UART communication speed"
        range 1200 115200
        default 19200
        help
            UART communication speed for Modbus Master.

    config MB_UART_RXD
        int "UART RXD pin number"
        range 0 48 if IDF_TARGET_ESP32C6
        default 5 if IDF_TARGET_ESP32C6
        help
            GPIO number for UART RX pin.

    config MB_UART_TXD
        int "UART TXD pin number" 
        range 0 48 if IDF_TARGET_ESP32C6
        default 4 if IDF_TARGET_ESP32C6
        help
            GPIO number for UART TX pin.

    config MB_UART_RTS
        int "UART RTS pin number"
        range 0 48 if IDF_TARGET_ESP32C6  
        default 2 if IDF_TARGET_ESP32C6
        help
            GPIO number for UART RTS pin. Used for RS485 direction control.

    choice MB_COMM_MODE
        prompt "Modbus communication mode"
        default MB_COMM_MODE_RTU if CONFIG_FMB_COMM_MODE_RTU_EN
        help
            Selection of Modbus communication mode option for Master.

        config MB_COMM_MODE_RTU
            bool "RTU mode"
            depends on FMB_COMM_MODE_RTU_EN

        config MB_COMM_MODE_ASCII
            bool "ASCII mode"
            depends on FMB_COMM_MODE_ASCII_EN

    endchoice

    config MB_SLAVE_ADDR
        int "Modbus slave address"
        range 1 247
        default 197
        help
            Modbus slave address for communication.

endmenu

menu "DEVICE WiFi Configuration"

    config DEVICE_AP_SSID
        string "Access Point SSID"
        default "DEVICE-CONFIG"
        help
            SSID for the configuration Access Point.

    config DEVICE_AP_PASSWORD
        string "Access Point Password"
        default "mosaico123"
        help
            Password for the configuration Access Point.

    config DEVICE_CONFIG_TIMEOUT
        int "Configuration timeout (seconds)"
        range 60 1800
        default 300
        help
            Time in seconds to wait for user configuration before fallback.

    config DEVICE_DEFAULT_API_HOST
        string "Default API Host"
        default "192.168.1.100"
        help
            Default API server host address.

    config DEVICE_DEFAULT_API_PORT
        string "Default API Port"
        default "5000"
        help
            Default API server port.

endmenu
```

## stageMosaicoIoT/sdkconfig.defaults
```kconfig
# Flash configuration for ESP32-C6 2MB - NO OTA
CONFIG_ESPTOOLPY_FLASHSIZE_2MB=y
CONFIG_ESPTOOLPY_FLASHSIZE="2MB"

# Disabilita OTA per risparmiare spazio
CONFIG_BOOTLOADER_APP_ROLLBACK_ENABLE=n
CONFIG_BOOTLOADER_DATA_IN_RTCMEM=n

# Modbus configuration - Force RTU mode
CONFIG_FMB_COMM_MODE_RTU_EN=y
CONFIG_FMB_COMM_MODE_ASCII_EN=n
CONFIG_FMB_MASTER_TIMEOUT_MS_RESPOND=1000
CONFIG_FMB_MASTER_DELAY_MS_CONVERT=200
CONFIG_FMB_QUEUE_LENGTH=20
CONFIG_FMB_PORT_TASK_STACK_SIZE=4096
CONFIG_FMB_SERIAL_TASK_STACK_SIZE=4096
CONFIG_FMB_PORT_TASK_PRIO=10
CONFIG_FMB_SERIAL_TASK_PRIO=10

# Debug configuration
CONFIG_LOG_DEFAULT_LEVEL_VERBOSE=y
CONFIG_LOG_MAXIMUM_LEVEL=5

# UART configuration for ESP32-C6
CONFIG_MB_UART_PORT_NUM=1
CONFIG_MB_UART_BAUD_RATE=19200
CONFIG_MB_UART_TXD=4
CONFIG_MB_UART_RXD=5
CONFIG_MB_UART_RTS=2
CONFIG_MB_COMM_MODE_RTU=y
CONFIG_MB_SLAVE_ADDR=197

# ESP32-C6 specific
CONFIG_IDF_TARGET="esp32c6"

# Partitions (SENZA OTA)
CONFIG_PARTITION_TABLE_CUSTOM=y
CONFIG_PARTITION_TABLE_CUSTOM_FILENAME="partitions.csv"
CONFIG_PARTITION_TABLE_FILENAME="partitions.csv"

# Ottimizzazioni HTTP Server per evitare "Header fields too long"
CONFIG_HTTPD_MAX_REQ_HDR_LEN=2048
CONFIG_HTTPD_MAX_URI_LEN=1024
CONFIG_HTTPD_RESP_BUF_SIZE=2048
CONFIG_HTTPD_PURGE_BUF_LEN=64

# Ottimizzazioni memoria per 2MB flash
CONFIG_ESP_MAIN_TASK_STACK_SIZE=8192
CONFIG_ESP_SYSTEM_EVENT_TASK_STACK_SIZE=4096

# Ottimizzazioni dimensioni app (importante senza OTA)
CONFIG_COMPILER_OPTIMIZATION_SIZE=y
CONFIG_BOOTLOADER_COMPILER_OPTIMIZATION_SIZE=y
CONFIG_COMPILER_OPTIMIZATION_ASSERTIONS_SILENT=y

# WiFi ottimizzazioni per memoria
CONFIG_ESP32_WIFI_AMPDU_TX_ENABLED=n
CONFIG_ESP32_WIFI_AMPDU_RX_ENABLED=n
CONFIG_ESP_WIFI_STATIC_RX_BUFFER_NUM=6
CONFIG_ESP_WIFI_DYNAMIC_RX_BUFFER_NUM=12
CONFIG_ESP_WIFI_STATIC_TX_BUFFER_NUM=6
CONFIG_ESP_WIFI_DYNAMIC_TX_BUFFER_NUM=12

# Configurazioni per supportare 392 registri
CONFIG_FREERTOS_HZ=1000
CONFIG_ESP_TASK_WDT_TIMEOUT_S=30

# NVS ottimizzato per chunked storage (32KB disponibili!)
CONFIG_NVS_MAX_BLOB_SIZE=8192

# MQTT buffer aumentati per 392 registri
CONFIG_MQTT_BUFFER_SIZE=40960
CONFIG_MQTT_OUTBOX_SIZE=8192

# Network ottimizzato
CONFIG_LWIP_TCP_MSS=1440
CONFIG_LWIP_TCP_WND_DEFAULT=32768

# SPIFFS ottimizzato per file grandi
CONFIG_SPIFFS_MAX_PARTITIONS=1
CONFIG_SPIFFS_CACHE=y
CONFIG_SPIFFS_CACHE_WR=y
CONFIG_SPIFFS_PAGE_CHECK=y
```
